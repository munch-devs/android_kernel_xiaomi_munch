## drivers/input/touchscreen/fts_spi/Kconfig
```kconfig
config TOUCHSCREEN_ST_FTS_V521_SPI
	tristate "ST FTS V521 I2C Touchscreen"
	depends on I2C
	help
	  Say Y here if you have ST FTS series I2C touchscreen.

	  If unsure, say N.

	  To compile this driver as a module, choose M here: the
	  module will be called fts_touch_spi.

config TOUCHSCREEN_ST_FTS_DEBUG
	tristate "Enable debug"
	depends on TOUCHSCREEN_ST_FTS_V521_SPI
	help 
          Say Y here to enable debugging.

          If unsure, say N.
```
